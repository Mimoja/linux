## arch/arm/mach-nintendo3ds/Kconfig
```kconfig
menu "Nintendo 3DS model type"
	depends on ARCH_NINTENDO3DS

config NINTENDO3DS_DT
	bool "Support Nintendo 3DS Device Tree based boot"
	select ARM_GIC
	select USE_OF
	select ARCH_REQUIRE_GPIOLIB
	select PINCTRL
	help
	  Include support for booting the Nintendo 3DS
	  using a device tree machine description.

endmenu
```
